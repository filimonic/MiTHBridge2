## main/Kconfig
```kconfig
menu "MiTH Bridge 2"
    menu "Startup configuration"
        config MITHBRIDGE2_STARTUP_TIMEOUT_MINUTES
            int "Maximum time startup takes (minutes)"
            default 5
            range 1 60
            help
                If the device cannot connect to WiFi and sync time within this 
                period, it will perform a software restart.
    endmenu

    menu "Sensor configuration"
        config MITHBRIDGE2_MAX_SENSOR_DATA_COUNT
            int "c"
            default 128
            range 1 65535
            help 
                Maximum sensors data can be remebered that was not sent to server (see "Send configuration")
    endmenu
    
    menu "Storage configuration"
        config MITHBRIDGE2_STORAGE_NVS_NS
            string "NVS Namespace name"
            default "mithbr2"
            help 
                Namespace on NVS Flash to store properties
    endmenu

    menu "Wi-Fi configuration"
        config MITHBRIDGE2_WIFI_RECONNECT_DELAY_SECONDS
            int "Delay before Wi-Fi reconnection attempt (seconds)"
            default 30
            range 5 60
            help
                Delay before Wi-Fi reconnection attempt (seconds)
    endmenu

    menu "Send configuration"
        config MITHBRIDGE2_SEND_INTERVAL_SECONDS
            int "How often to send collected data (seconds)"
            default 45
            range 30 300
            help 
                How often to send collected data from sensors
        config MITHBRIDGE2_SEND_MAX_EMPTY_TIME_MINUTES
            int "Maximum amount of time (minutes) when no sensor data is sent (any reason)"
            default 7
            range 5 30
            help 
                Maximum amount of time (minutes) when no sensor data is sent (any reason). If none is sent, device will restart.\
                Reasons may be: no sensor data, no wifi, other communication problems.
    endmenu

    menu "LED Flasher Configuration"
        config MITHBRIDGE2_LED_FLASHER_ENABLED
        bool "Enable LED Flasher"
        default y
        help
            Enable or disable the LED flasher feature.

        config MITHBRIDGE2_LED_FLASHER_QUEUE_SIZE
        int "Led flasher event queue size"
        depends on MITHBRIDGE2_LED_FLASHER_ENABLED
        range 10 255
        default 255
        help
            Size of queued led flash signals.

        config MITHBRIDGE2_LED_FLASHER_DUPLICATES_ENABLED
        bool "Flash on duplicate packets too"
        depends on MITHBRIDGE2_LED_FLASHER_ENABLED
        default y
        help
            Flash duplicate packets too.

        config MITHBRIDGE2_LED_FLASHER_LED_GPIO
        int "LED GPIO Number"
        depends on MITHBRIDGE2_LED_FLASHER_ENABLED
        range 0 39
        default 15
        help
            GPIO number for the LED.

        config MITHBRIDGE2_LED_FLASHER_INVERTED
        bool "Inverted LED"
        depends on MITHBRIDGE2_LED_FLASHER_ENABLED
        default y
        help
            Invert LED logic.

        config MITHBRIDGE2_LED_FLASHER_ON_INTERVAL_MS
        int "LED Flash ON Interval (ms)"
        depends on MITHBRIDGE2_LED_FLASHER_ENABLED
        range 100 2000
        default 150
        help
            Duration on ON state of LED. For duplicate packets it's twice (ON + ON). For non-duplicate packets it's 3x (ON + OFF + ON).

        config MITHBRIDGE2_LED_FLASHER_OFF_INTERVAL_MS
        int "LED Flash OFF Interval (ms)"
        depends on MITHBRIDGE2_LED_FLASHER_ENABLED
        range 100 2000
        default 600
        help
            Minimal interval in milliseconds between LED signals.
    endmenu

#   menu "SNTP Servers (predefined)"
#       config MITHBRIDGE2_SNTP_SERVER_1_ADDRESS
#           string "SNTP server 1 address"
#           default "time.google.com"
#           help
#               Enter the Hostname (e.g., pool.ntp.org) or IP Address
#
#       config MITHBRIDGE2_SNTP_SERVER_2_ADDRESS
#           string "SNTP server 2 address"
#           default "time.cloudflare.com"
#           help
#               Enter the Hostname (e.g., pool.ntp.org) or IP Address
#
#       config MITHBRIDGE2_SNTP_SERVER_3_ADDRESS
#           string "SNTP server 3 address"
#           default "pool.ntp.org"
#           help
#               Enter the Hostname (e.g., pool.ntp.org) or IP Address
#   endmenu
endmenu
```

## sdkconfig.defaults
```kconfig
#CONFIG_LOG_DEFAULT_LEVEL_DEBUG=y
#CONFIG_LOG_DEFAULT_LEVEL=4
#CONFIG_LOG_MAXIMUM_LEVEL_VERBOSE=y
#CONFIG_LOG_MAXIMUM_LEVEL=5

CONFIG_ESP_COEX_SW_COEXIST_ENABLE=y

### BLE-related
CONFIG_BT_ENABLED=y
CONFIG_BT_CONTROLLER_ENABLED=y
CONFIG_BT_NIMBLE_ENABLED=y
CONFIG_BT_NIMBLE_ROLE_OBSERVER=y
CONFIG_BT_NIMBLE_50_FEATURE_SUPPORT=y
CONFIG_BT_NIMBLE_LL_CFG_FEAT_LE_2M_PHY=y
CONFIG_BT_NIMBLE_LL_CFG_FEAT_LE_CODED_PHY=y
CONFIG_BT_NIMBLE_EXT_ADV=y
CONFIG_BT_NIMBLE_EXT_SCAN=y
# CONFIG_BT_NIMBLE_ENABLE_PERIODIC_SYNC is not set
# CONFIG_BT_NIMBLE_ENABLE_PERIODIC_ADV is not set

# CONFIG_BT_NIMBLE_ROLE_CENTRAL is not set
# CONFIG_BT_NIMBLE_ROLE_PERIPHERAL is not set
# CONFIG_BT_NIMBLE_ROLE_BROADCASTER is not set
# CONFIG_BT_NIMBLE_SECURITY_ENABLE is not set
# CONFIG_BT_NIMBLE_HS_PVCY is not set
# CONFIG_BT_LE_SCAN_DUPL is not set

### LWIP-related
# CONFIG_LWIP_DNS_SUPPORT_MDNS_QUERIES is not set
# CONFIG_LWIP_DHCPS is not set

### Wi-Fi related
CONFIG_ESP_WIFI_11R_SUPPORT=y
# CONFIG_ESP_WIFI_SOFTAP_SUPPORT is not set
# CONFIG_ESP_WIFI_NVS_ENABLED is not set
# CONFIG_ESP_WIFI_ENTERPRISE_SUPPORT is not set

CONFIG_LWIP_SNTP_MAX_SERVERS=3
CONFIG_LWIP_DHCP_GET_NTP_SRV=y
CONFIG_LWIP_DHCP_MAX_NTP_SERVERS=2
CONFIG_LWIP_SNTP_UPDATE_DELAY=900000
CONFIG_LWIP_SNTP_STARTUP_DELAY=y
CONFIG_LWIP_SNTP_MAXIMUM_STARTUP_DELAY=5000

CONFIG_ESP_HTTP_CLIENT_ENABLE_HTTPS=y
CONFIG_ESP_HTTP_CLIENT_ENABLE_BASIC_AUTH=y


# Partition Table
#
# CONFIG_PARTITION_TABLE_SINGLE_APP is not set
# CONFIG_PARTITION_TABLE_SINGLE_APP_LARGE is not set
# CONFIG_PARTITION_TABLE_TWO_OTA is not set
# CONFIG_PARTITION_TABLE_TWO_OTA_LARGE is not set
CONFIG_PARTITION_TABLE_CUSTOM=y
CONFIG_PARTITION_TABLE_CUSTOM_FILENAME="partitions.csv"
CONFIG_PARTITION_TABLE_FILENAME="partitions.csv"
CONFIG_PARTITION_TABLE_OFFSET=0x8000
CONFIG_PARTITION_TABLE_MD5=y
```

## sdkconfig.defaults.esp32c6
```kconfig
# MAC Config
CONFIG_ESP_MAC_ADDR_UNIVERSE_WIFI_STA=y
CONFIG_ESP_MAC_ADDR_UNIVERSE_BT=y
CONFIG_ESP_MAC_UNIVERSAL_MAC_ADDRESSES_TWO=y
CONFIG_ESP_MAC_UNIVERSAL_MAC_ADDRESSES=2
CONFIG_ESP32C6_UNIVERSAL_MAC_ADDRESSES_TWO=y
# CONFIG_ESP32C6_UNIVERSAL_MAC_ADDRESSES_FOUR is not set
CONFIG_ESP32C6_UNIVERSAL_MAC_ADDRESSES=2
# CONFIG_ESP_MAC_USE_CUSTOM_MAC_AS_BASE_MAC is not set

#
# ESP-STDIO
#
# CONFIG_ESP_CONSOLE_UART_DEFAULT is not set
CONFIG_ESP_CONSOLE_USB_SERIAL_JTAG=y
# CONFIG_ESP_CONSOLE_UART_CUSTOM is not set
# CONFIG_ESP_CONSOLE_NONE is not set
CONFIG_ESP_CONSOLE_SECONDARY_NONE=y
CONFIG_ESP_CONSOLE_USB_SERIAL_JTAG_ENABLED=y
CONFIG_ESP_CONSOLE_UART_NUM=-1
CONFIG_ESP_CONSOLE_ROM_SERIAL_PORT_NUM=3
```
